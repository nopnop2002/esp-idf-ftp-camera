## main/Kconfig.projbuild
```kconfig
menu "Application configuration"

	menu "WiFi Setting"

		config ESP_WIFI_SSID
			string "WiFi SSID"
			default "myssid"
			help
				SSID (network name) to connect to.

		config ESP_WIFI_PASSWORD
			string "WiFi Password"
			default "mypassword"
			help
				WiFi password (WPA or WPA2) to connect to.

		config ESP_MAXIMUM_RETRY
			int "Maximum retry"
			default 5
			help
				Set the Maximum retry to avoid station reconnecting to the AP unlimited when the AP is really inexistent.

		config MDNS_HOSTNAME
			string "mDNS Hostname"
			default "esp32-camera"
			help
				The mDNS host name used by the ESP32.

		config STATIC_IP
			bool "Enable Static IP Address"
			default false
			help
				Enable Static IP Address.

		config STATIC_IP_ADDRESS
			depends on STATIC_IP
			string "Static IP Address"
			default "192.168.10.100"
			help
				Static IP Address for Station.

		config STATIC_GW_ADDRESS
			depends on STATIC_IP
			string "Static GW Address"
			default "192.168.10.1"
			help
				Static GW Address for Station.

		config STATIC_NM_ADDRESS
			depends on STATIC_IP
			string "Static Netmask"
			default "255.255.255.0"
			help
				Static Netmask for Station.
	endmenu


	menu "FTP Server Setting"

		config FTP_SERVER
			string "FTP Server"
			default "myftpserver.local"
			help
				The host name or IP address of the FTP server to use.

		config FTP_USER
			string "FTP User Name"
			default "myftpuser"
			help
				FTP user name to use.

		config FTP_PASSWORD
			string "FTP Password"
			default "myftppass"
			help
				FTP password to use.

		config ENABLE_SUBDIR
			bool "Save pictures in remote subdirectories"
			default n
			help
				Save pictures in subdirectories.

		config FTP_SUBDIR
			depends on ENABLE_SUBDIR
			string "Remote subdirectory to store pictures"
			default "pictures"
			help
				Remote subdirectory to store pictures.

		config CREATE_INDEX_HTML
			bool "Create index.html on FTP Server"
			default n
			help
				Create index.html on FTP Server.
				You can view pictures when the FTP server is also acting as an HTTP server.

		config INDEX_HTML_SUBDIR
			depends on CREATE_INDEX_HTML
			string "Remote subdirectory to store index.html"
			default "html"
			help
				Remote subdirectory to store index.html.

		choice IMAGE_ROTATE
			depends on CREATE_INDEX_HTML
			bool "Select Image Rotate"
			default IMAGE_ROTATE_0
			help
				Select Image Rotate.

			config IMAGE_ROTATE_0
				bool "Rotate(0deg)"
			config IMAGE_ROTATE_90
				bool "Rotate(90deg)"
			config IMAGE_ROTATE_180
				bool "Rotate(180deg)"
			config IMAGE_ROTATE_270
				bool "Rotate(270deg)"
		endchoice


	endmenu


	menu "Remote File Name Setting"

		choice REMOTE_FILE
			bool "Select remote file name"
			default REMOTE_IS_FIXED_NAME
			help
				Select remote file name.

			config REMOTE_IS_FIXED_NAME
				bool "Remote file name is fixed"
			config REMOTE_IS_VARIABLE_NAME
				bool "Remote file name is date and time"
		endchoice

		config FIXED_REMOTE_FILE
			depends on REMOTE_IS_FIXED_NAME
			string "Fixed-Remote file name"
			default "picture.jpg"
			help
				Remote file name.

		config NTP_SERVER
			depends on REMOTE_IS_VARIABLE_NAME
			string "NTP Server"
			default "pool.ntp.org"
			help
				Hostname for NTP Server.

		config LOCAL_TIMEZONE
			depends on REMOTE_IS_VARIABLE_NAME
			int "Your TimeZone"
			range -23 23
			default 0
			help
				Your local timezone.  When it is 0, Greenwich Mean Time.

		config REMOTE_FRAMESIZE
			bool "Add FrameSize to Remote file name"
			default false
			help
				Add FrameSize to Remote file name.

	endmenu

	choice BOARD
		bool "Select Board"
		default BOARD_ESP32CAM_AITHINKER
		help
			Select Board Type.

		config BOARD_ESP32_WROVER_FREENOVE
			bool "Freenove ESP32-WROVER CAM Board"
		config BOARD_ESP32S3_WROOM_FREENOVE
			bool "Freenove ESP32S3-WROOM CAM Board"
		config BOARD_CAMERA_MODEL_ESP_EYE
			bool "Espressif ESP-EYE"
		config BOARD_ESP32CAM_AITHINKER
			bool "AiThinker ESP32-CAM"
		config BOARD_CAMERA_MODEL_TTGO_T_JOURNAL
			bool "TTGO T-Journal ESP32 Camera"
		config BOARD_ESPS3_CAM_UICPAL
			bool "UICPAL ESPS3 CAM RE:1.0"
	endchoice

	choice FRAMESIZE
		bool "Select Frame Size"
		default FRAMESIZE_VGA
		help
			Select Picture Frame Size.

		config FRAMESIZE_VGA
			bool "Frame Size:640x480"
		config FRAMESIZE_SVGA
			bool "Frame Size:800x600"
		config FRAMESIZE_XGA
			bool "Frame Size:1024x768"
		config FRAMESIZE_HD
			bool "Frame Size:1280x720"
		config FRAMESIZE_SXGA
			bool "Frame Size:1280x1024"
		config FRAMESIZE_UXGA
			bool "Frame Size:1600x1200"
	endchoice


	menu "Select Shutter"

		choice SHUTTER_SELECT
			bool "Select Shutter"
			default SHUTTER_ENTER
			help
				Selecting the shutter method

			config SHUTTER_ENTER
				bool "Use Enter key"
			config SHUTTER_GPIO
				bool "Use GPIO"
			config SHUTTER_TCP
				bool "Use TCP Socket"
			config SHUTTER_UDP
				bool "Use UDP Socket"
			config SHUTTER_HTTP
				bool "Use HTTP Request"
			config SHUTTER_MQTT
				bool "Use MQTT Subscribe"
			config SHUTTER_REMOTE_FILE
				bool "Use REMOTE file polling"
		endchoice

		config GPIO_INPUT
			depends on SHUTTER_GPIO
			int "Input GPIO number"
			range 4 34
			default 15
			help
				GPIO number (IOxx) to Button Input.
				Some GPIOs are used for other purposes (flash connections, etc.) and cannot be used to Button.

		choice GPIO_INITIAL
			depends on SHUTTER_GPIO
			prompt "GPIO Initial state"
			default GPIO_PULLDOWN
			help
				Select initial state of GPIO.

			config GPIO_PULLUP
				bool "GPIO_PULLUP"
				help
					The initial state of GPIO is Pull-UP.

			config GPIO_PULLDOWN
				bool "GPIO_PULLDOWN"
				help
					The initial state of GPIO is Pull-Down.

		endchoice

		config TCP_PORT
			depends on SHUTTER_TCP
			int "TCP Port"
			range 49152 65535
			default 49876
			help
				Local port TCP server will listen on.

		config UDP_PORT
			depends on SHUTTER_UDP
			int "UDP Port"
			range 49152 65535
			default 49876
			help
				Local port UDP server will listen on.

		config SHUTTER_URL
			depends on SHUTTER_HTTP
			string "URL for built-in WEB server"
			default "/take/picture"
			help
				URL for built-in WEB server.
				Must start with /.

		config MQTT_BROKER
			depends on SHUTTER_MQTT
			string "MQTT Broker"
			default "broker.emqx.io"
			help
				Host name or IP address of the broker to connect to

		config MQTT_SUB_TOPIC
			depends on SHUTTER_MQTT
			string "Subscribe Topic"
			default "/take/picture"
			help
				Topic of subscribe

		config MQTT_RESTART
			depends on SHUTTER_MQTT
			bool "Restart when disconnected from MQTT server"
			default false
			help
				Restart when disconnected from MQTT server

		config BROKER_AUTHENTICATION
			depends on SHUTTER_MQTT
			bool "Server requests for password when connecting"
			default false
			help
				Server requests for password when connecting

		config AUTHENTICATION_USERNAME
			depends on BROKER_AUTHENTICATION
			string "Username used for connecting to the broker"
			default "user"
			help
				Username used for connecting to the broker

		config AUTHENTICATION_PASSWORD
			depends on BROKER_AUTHENTICATION
			string "Password used for connecting to the broker"
			default "password"
			help
				Password used for connecting to the broker

		config REMOTE_FILE_NAME
			depends on SHUTTER_REMOTE_FILE
			string "Remote file name for polling"
			default "shutter.txt"
			help
				Remote file name for polling.

		choice REMOTE_FILE_ACTION
			depends on SHUTTER_REMOTE_FILE
			prompt "Remote file action"
			default REMOTE_FILE_CREATE
			help
				Select remote file action.

			config REMOTE_FILE_CREATE
				bool "Triggered on remote file creation"
				help
					Triggered on remote file creation.

			config REMOTE_FILE_REMOVE
				bool "Trigger on remote file deletion"
				help
					Trigger on remote file deletion.

		endchoice

	endmenu

	config ENABLE_FLASH
		bool "Enable Flash Light"
		default n
		help
			Enable Flash Light.

	config GPIO_FLASH
		depends on ENABLE_FLASH
		int "Flash GPIO number"
		range 4 34
		default 4
		help
			GPIO number (IOxx) to Button Input.
			Some GPIOs are used for other purposes (flash connections, etc.) and cannot be used to Button.


endmenu
```
